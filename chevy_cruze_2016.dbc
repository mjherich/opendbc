VERSION ""

NS_ :

BS_:

BU_: XXX

BO_ 241 BRAKING: 8 NEW_TRANSMITTER_1
 SG_ Pressure : 15|8@0+ (1,0) [0|255] "" XXX
 SG_ Bool : 1|1@1+ (1,0) [0|1] "" XXX

 BO_ 368 EBCMFrictionBrakeStatus: 8 K17_EBCM
  SG_ FrictionBrakePressure : 23|16@0+ (1,0) [0|0] ""  XXX
